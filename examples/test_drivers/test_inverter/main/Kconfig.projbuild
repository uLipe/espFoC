## examples/test_drivers/test_voltage_path/main/Kconfig.projbuild
```kconfig
menu "Frerunning FoC example menu"

    config FOC_PWM_U_PIN
        int "Gpio number for PWM of phase U"
        range 0 34
        default 19

    config FOC_PWM_V_PIN
        int "Gpio number for PWM of phase V"
        range 0 34
        default 20

    config FOC_PWM_W_PIN
        int "Gpio number for PWM of phase W"
        range 0 46
        default 3

    config FOC_PWM_EN_PIN
        int "Gate driver enable GPIO (or -1 if not used; reserved for MCPWM tests)"
        range -1 54
        default -1

    config FOC_PWM_EN_ACT_LOW
        bool "Active-low enable (inverted)"
        default n
        depends on FOC_PWM_EN_PIN >= 0

endmenu
```

## examples/test_drivers/test_voltage_path/sdkconfig.defaults
```kconfig
CONFIG_ESP_FOC_SCOPE=n
CONFIG_COMPILER_OPTIMIZATION_PERF=y
CONFIG_ESP_FOC_DEBUG_CORE_TIMING=n
CONFIG_FREERTOS_ISR_STACKSIZE=4096
CONFIG_ESP_FOC_USE_SINE_PWM=n
```

## examples/test_projects/test_current_sense/main/Kconfig.projbuild
```kconfig
menu "Frerunning FoC example menu"

    config FOC_PWM_U_PIN
        int "Gpio number for PWM of phase U"
        range 0 34
        default 20

    config FOC_PWM_V_PIN
        int "Gpio number for PWM of phase V"
        range 0 34
        default 3

    config FOC_PWM_W_PIN
        int "Gpio number for PWM of phase W"
        range 0 46
        default 46

    config FOC_PWM_EN_PIN
        int "Gpio number for PWM of phase W"
        range 0 34
        default 21

    config FOC_ENCODER_SDA_PIN
        int "Encoder sensor sda pin value"
        range 0 34
        default 8

    config FOC_ENCODER_SCL_PIN
        int "Encoder sensor scl pin value"
        range 0 34
        default 9

endmenu
```

## examples/test_projects/test_encoder/main/Kconfig.projbuild
```kconfig
menu "Frerunning FoC example menu"

    config FOC_ENCODER_SDA_PIN
        int "Encoder sensor sda pin value"
        range 0 34
        default 8

    config FOC_ENCODER_SCL_PIN
        int "Encoder sensor scl pin value"
        range 0 34
        default 9

    config FOC_ENCODER_MISO_PIN
        int "Encoder sensor scl pin value"
        range 0 34
        default 4

    config FOC_ENCODER_MOSI_PIN
        int "Encoder sensor scl pin value"
        range 0 34
        default 5

    config FOC_ENCODER_SCK_PIN
        int "Encoder sensor scl pin value"
        range 0 34
        default 6

    config FOC_ENCODER_CS_PIN
        int "Encoder sensor scl pin value"
        range 0 34
        default 7

endmenu
```

## examples/tuner_demo/sdkconfig.defaults
```kconfig
# Disable task watchdog so the demo task can run without periodic feed
CONFIG_ESP_TASK_WDT_EN=n

# Enable runtime tuner backend
CONFIG_ESP_FOC_TUNER_ENABLE=y

CONFIG_ESP_FOC_PWM_RATE_HZ=20000
```

## examples/tuner_studio_target/main/Kconfig.projbuild
```kconfig
menu "TunerStudio target — pin map"

    config TUNER_TARGET_PWM_U_HI
        int "PWM U high pin"
        range 0 54
        default 5

    config TUNER_TARGET_PWM_V_HI
        int "PWM V high pin"
        range 0 54
        default 6

    config TUNER_TARGET_PWM_W_HI
        int "PWM W high pin"
        range 0 54
        default 7

    config TUNER_TARGET_PWM_U_LO
        int "PWM U low pin"
        range 0 54
        default 15

    config TUNER_TARGET_PWM_V_LO
        int "PWM V low pin"
        range 0 54
        default 16

    config TUNER_TARGET_PWM_W_LO
        int "PWM W low pin"
        range 0 54
        default 17

    config TUNER_TARGET_PWM_FREQ_HZ
        int "PWM frequency [Hz]"
        default 20000

    config TUNER_TARGET_DC_LINK_V
        int "DC link voltage (Volts)"
        default 12

    config TUNER_TARGET_ENC_SDA
        int "Encoder I2C SDA pin"
        range 0 54
        default 4

    config TUNER_TARGET_ENC_SCL
        int "Encoder I2C SCL pin"
        range 0 54
        default 8

    config TUNER_TARGET_POLE_PAIRS
        int "Motor pole pairs"
        range 1 64
        default 7

    comment "ADC shunt current sensing"

    config TUNER_TARGET_ISENSE_ADC_UNIT
        int "ADC unit (1 or 2)"
        range 1 2
        default 1

    config TUNER_TARGET_ISENSE_CH_U
        int "ADC channel for phase U shunt"
        range 0 9
        default 1

    config TUNER_TARGET_ISENSE_CH_V
        int "ADC channel for phase V shunt"
        range 0 9
        default 5

    config TUNER_TARGET_ISENSE_AMP_GAIN_X100
        int "Current amplifier gain (V/V) x100"
        range 1 100000
        default 5000
        help
            Stored x100 because Kconfig int does not accept floats.
            Default 5000 -> 50.0 V/V (typical INA240A2).

    config TUNER_TARGET_ISENSE_SHUNT_MOHM
        int "Shunt resistance (milli-ohm)"
        range 1 10000
        default 10
        help
            10 mOhm matches the SimpleFOCShield-style boards.

endmenu
```

## examples/tuner_studio_target/sdkconfig.defaults
```kconfig
# TunerStudio service-mode firmware. Boots, attaches to the tuner,
# parks the motor at zero current, then waits for the GUI to drive
# alignment / current steps / persistence. No application logic.

CONFIG_ESP_TASK_WDT_EN=n

# Tuner runtime + transport (USB-CDC default; switch to UART via
# menuconfig when targeting plain ESP32).
CONFIG_ESP_FOC_TUNER_ENABLE=y
CONFIG_ESP_FOC_BRIDGE_NONE=n
CONFIG_ESP_FOC_BRIDGE_USBCDC=y

# TinyUSB CDC needed by the USB-CDC bridge.
CONFIG_TINYUSB_CDC_ENABLED=y

# Scope + injection so the GUI's hexagon and step buttons just work.
# Default scope buffer is 4096 frames * 8 channels which fits big SRAM
# parts but blows DRAM on plain ESP32 / S3. 512 frames is plenty for
# the GUI's 50 FPS rolling view and keeps RAM headroom.
CONFIG_ESP_FOC_SCOPE=y
CONFIG_ESP_FOC_SCOPE_NUM_CHANNELS=12
CONFIG_ESP_FOC_SCOPE_BUFFER_SIZE=512
CONFIG_ESP_FOC_INJECTION_ENABLE=y

# Calibration overlay so persisted gains survive reboots.
CONFIG_ESP_FOC_CALIBRATION_NVS=y

# Build-time autotuner with the default profile — overridden at boot
# by NVS calibration once the operator has saved one.
CONFIG_ESP_FOC_USE_AUTOGEN_GAINS=y
CONFIG_ESP_FOC_MOTOR_PROFILE="default"
CONFIG_ESP_FOC_AUTOGEN_PWM_RATE_HZ=20000
CONFIG_ESP_FOC_AUTOGEN_DECIMATION=20
```

## examples/tuner_studio_target/sdkconfig.defaults.esp32
```kconfig
# Plain ESP32 has no USB-CDC peripheral, switch the tuner bridge to
# UART. ESP-IDF auto-loads this file on top of sdkconfig.defaults
# whenever `idf.py set-target esp32` is run.

CONFIG_ESP_FOC_BRIDGE_USBCDC=n
CONFIG_ESP_FOC_BRIDGE_UART=y
CONFIG_TINYUSB_CDC_ENABLED=n
```
