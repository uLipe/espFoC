## examples/axis_sensored/sdkconfig.defaults
```kconfig
CONFIG_FREERTOS_FPU_IN_ISR=y
CONFIG_ESP_FOC_SCOPE=y
CONFIG_COMPILER_OPTIMIZATION_PERF=y
CONFIG_ESP_FOC_DEBUG_CORE_TIMING=y
CONFIG_ADC_CONTINUOUS_ISR_IRAM_SAFE=y
CONFIG_TINYUSB_CDC_ENABLED=y
CONFIG_ESP_FOC_SCOPE_BUFFER_SIZE=2048
```

## examples/axis_sensorless/main/Kconfig.projbuild
```kconfig
menu "Frerunning FoC example menu"

    config EXAMPLE_BUILD_INCOMPLETE_SENSORLESS
        bool "Build the sensorless example even though support is WIP"
        default n
        help
            Sensorless FOC requires a rotor position observer that has
            not yet been wired into the axis. Compiling this example
            today produces a binary that initializes the inverter but
            cannot run a closed loop. Set this to y if you want to
            proceed anyway (e.g. while developing the observer); the
            app will still print an error and exit early at runtime.


    config FOC_PWM_U_PIN
        int "Gpio number for PWM of phase U"
        range 0 34
        default 5

    config FOC_PWM_V_PIN
        int "Gpio number for PWM of phase V"
        range 0 34
        default 20

    config FOC_PWM_W_PIN
        int "Gpio number for PWM of phase W"
        range 0 46
        default 7

    config FOC_PWM_EN_PIN
        int "Gpio number for PWM of phase W"
        range 0 34
        default 19

    config FOC_TEST_6_PWM
        bool "Enable test for the 6-MCPWM"
        default y

    config FOC_PWM_UL_PIN
        int "Gpio number for PWM of phase U low"
        depends on FOC_TEST_6_PWM
        range 0 34
        default 6

    config FOC_PWM_VL_PIN
        int "Gpio number for PWM of phase V low"
        range 0 34
        depends on FOC_TEST_6_PWM
        default 21

    config FOC_PWM_WL_PIN
        int "Gpio number for PWM of phase W low"
        range 0 46
        depends on FOC_TEST_6_PWM
        default 8

    config FOC_ENCODER_SDA_PIN
        int "Encoder sensor sda pin value"
        range 0 34
        default 17

    config FOC_ENCODER_SCL_PIN
        int "Encoder sensor scl pin value"
        range 0 34
        default 18

endmenu
```

## examples/axis_shell/sdkconfig.defaults
```kconfig
# axis_shell — console shell; FITL plant by default.

CONFIG_ESP_TASK_WDT_EN=n

CONFIG_ESP_FOC_CALIBRATION_NVS=y
CONFIG_ESPFOC_SHELL=y
CONFIG_ESP_FOC_PWM_RATE_HZ=20000

# QBL4208-61-04-013 (delta windings: R/L = line-line table values, 24 V bus)
CONFIG_FOC_ITL_MOTOR_DELTA=y
CONFIG_ESP_FOC_DC_LINK_NOMINAL_MV=24000
CONFIG_AXIS_TUNING_DC_LINK_V=24
CONFIG_FOC_ITL_DEFAULT_R_MILLIOHM=720
CONFIG_FOC_ITL_DEFAULT_L_UH=1200
CONFIG_FOC_ITL_DEFAULT_J_X1E7=480
CONFIG_FOC_ITL_DEFAULT_KT_X1E7=360000
CONFIG_FOC_ITL_DEFAULT_POLE_PAIRS=4
CONFIG_FOC_ITL_DEFAULT_I_MAX_MA=10600

CONFIG_AXIS_SHELL_PLANT_FITL=y
CONFIG_ESP_FOC_FITL=y
CONFIG_FOC_ITL_TICK_MCPWM=y

CONFIG_COMPILER_OPTIMIZATION_PERF=y
CONFIG_ADC_CONTINUOUS_ISR_IRAM_SAFE=y

CONFIG_ESP_CONSOLE_UART_DEFAULT=y
CONFIG_ESP_CONSOLE_SECONDARY_NONE=y
```

## examples/axis_shell/sdkconfig.defaults.esp32
```kconfig
# FITL + shell on esp32 QEMU (GPTimer tick, no scope bridge)
CONFIG_IDF_TARGET="esp32"

CONFIG_ESP_FOC_FITL=y
CONFIG_FOC_ITL_TICK_GPTIMER=y
CONFIG_FOC_ITL_TICK_MCPWM=n

CONFIG_ESPFOC_SHELL=y
CONFIG_ESP_FOC_SCOPE=n

CONFIG_ESP_TASK_WDT_EN=n

CONFIG_ESP_CONSOLE_UART_DEFAULT=y
CONFIG_ESP_CONSOLE_SECONDARY_NONE=y
```

## examples/axis_shell/sdkconfig.defaults.esp32s3
```kconfig
# esp32s3: scope on dedicated UART (console stays on default UART0)
CONFIG_ESP_FOC_STREAM_BRIDGE_UART=y
CONFIG_ESP_FOC_STREAM_BRIDGE_USBCDC=n
```

## examples/axis_tuning/main/Kconfig.projbuild
```kconfig
orsource "../../kconfig/hw_axis_tuning.kconfig"

choice AXIS_TUNING_ROTOR_SENSOR
    prompt "Rotor position sensor"
    default AXIS_TUNING_ROTOR_AS5600

    config AXIS_TUNING_ROTOR_AS5600
        bool "AS5600 (I2C magnetic encoder)"

    config AXIS_TUNING_ROTOR_SIMU
        bool "rotor_sensor_simu (open-loop, no hardware encoder)"
endchoice

menu "Simulated motor electrical model"
    depends on AXIS_TUNING_ROTOR_SIMU

    config AXIS_TUNING_SIMU_R_MILLIOHM
        int "Phase resistance R (milli-ohm)"
        range 1 1000000
        default 1000
        help
            Per-phase resistance used by rotor_sensor_simu (dq model).
            Default 1000 -> 1.0 ohm.

    config AXIS_TUNING_SIMU_L_MICROHENRY
        int "Phase inductance L (micro-henry)"
        range 1 1000000
        default 2000
        help
            Per-phase inductance. Default 2000 -> 2 mH (0.002 H).

endmenu
```

## examples/axis_tuning/sdkconfig.defaults
```kconfig
# axis_tuning — reference firmware with runtime tuner always enabled.
# Host drives align → run → tune → store → stop via tunerctl / Studio.

CONFIG_ESP_TASK_WDT_EN=n

CONFIG_ESP_FOC_TUNER_ENABLE=y
CONFIG_ESP_FOC_BRIDGE_NONE=n

CONFIG_ESP_FOC_SCOPE=y
CONFIG_ESP_FOC_SCOPE_NUM_CHANNELS=13
CONFIG_ESP_FOC_SCOPE_BUFFER_SIZE=512

CONFIG_ESP_FOC_CALIBRATION_NVS=y
CONFIG_ESP_FOC_PWM_RATE_HZ=20000

CONFIG_COMPILER_OPTIMIZATION_PERF=y
CONFIG_ADC_CONTINUOUS_ISR_IRAM_SAFE=y
```

## examples/axis_tuning/sdkconfig.defaults.esp32c6
```kconfig
CONFIG_ESP_FOC_BRIDGE_USBCDC=y
CONFIG_ESP_FOC_BRIDGE_UART=n

# Tuner owns USB Serial/JTAG; keep ROM logs on UART0.
CONFIG_ESP_CONSOLE_UART_DEFAULT=y
CONFIG_ESP_CONSOLE_SECONDARY_NONE=y
```

## examples/axis_tuning/sdkconfig.defaults.esp32p4
```kconfig
CONFIG_ESP_FOC_BRIDGE_USBCDC=y
CONFIG_ESP_FOC_BRIDGE_UART=n
CONFIG_TINYUSB_CDC_ENABLED=y
```

## examples/current_control/sdkconfig.defaults
```kconfig
CONFIG_FREERTOS_FPU_IN_ISR=y
CONFIG_ESP_FOC_SCOPE=y
CONFIG_ESP_FOC_USE_SINE_PWM=n
CONFIG_COMPILER_OPTIMIZATION_PERF=y
CONFIG_ESP_FOC_DEBUG_CORE_TIMING=y
```

## examples/freeruning_foc/main/Kconfig.projbuild
```kconfig
menu "Frerunning FoC example menu"

    config FOC_DEFAULT_MOTOR_POLE_PAIRS
        int "Target motor pole pairs"
        default 11
        help
            Motor pole pairs commonly found in the motor part 
            datasheet, 11 pole pairs are a common value, but correct
            value is important for correct electrical angle calculation.
            
    config FOC_PWM_U_PIN
        int "Gpio number for PWM of phase U"
        range 0 34
        default 14

    config FOC_PWM_V_PIN
        int "Gpio number for PWM of phase V"
        range 0 34
        default 13

    config FOC_PWM_W_PIN
        int "Gpio number for PWM of phase W"
        range 0 34
        default 12

    config FOC_ENCODER_SDA_PIN
        int "Encoder sensor sda pin value"
        range 0 34
        default 18
        
    config FOC_ENCODER_SCL_PIN
        int "Encoder sensor scl pin value"
        range 0 34
        default 19

endmenu
```

## examples/microROS_FoC/main/Kconfig.projbuild
```kconfig
menu "MicroROS plus FoC example menu"
    
    config MICRO_ROS_APP_STACK
        int "Stack the micro-ROS app (Bytes)"
        default 16000
        help
        Stack size in Bytes of the micro-ROS app

    config MICRO_ROS_APP_TASK_PRIO
        int "Priority of the micro-ROS app"
        default 5
        help
        Priority of micro-ros task higher value means higher priority

    config FOC_PWM_U_PIN
        int "Gpio number for PWM of phase U"
        range 0 34
        default 14

    config FOC_PWM_V_PIN
        int "Gpio number for PWM of phase V"
        range 0 34
        default 13

    config FOC_PWM_W_PIN
        int "Gpio number for PWM of phase W"
        range 0 34
        default 12

    config FOC_ENCODER_SDA_PIN
        int "Encoder sensor sda pin value"
        range 0 34
        default 18
        
    config FOC_ENCODER_SCL_PIN
        int "Encoder sensor scl pin value"
        range 0 34
        default 19

endmenu
```

## examples/open_loop/sdkconfig.defaults
```kconfig
CONFIG_FREERTOS_FPU_IN_ISR=y
CONFIG_ESP_FOC_SCOPE=n
CONFIG_ESP_FOC_USE_SINE_PWM=n
CONFIG_COMPILER_OPTIMIZATION_PERF=y
CONFIG_ESP_FOC_DEBUG_CORE_TIMING=y
```

## examples/simple_motor_tester/main/Kconfig.projbuild
```kconfig
menu "Frerunning FoC example menu"
            
    config FOC_PWM_U_PIN
        int "Gpio number for PWM of phase U"
        range 0 34
        default 13

    config FOC_PWM_V_PIN
        int "Gpio number for PWM of phase V"
        range 0 34
        default 27

    config FOC_PWM_W_PIN
        int "Gpio number for PWM of phase W"
        range 0 34
        default 16

    config FOC_ENCODER_SDA_PIN
        int "Encoder sensor sda pin value"
        range 0 34
        default 18
        
    config FOC_ENCODER_SCL_PIN
        int "Encoder sensor scl pin value"
        range 0 34
        default 19

   config FOC_ENCODER_A_PIN
        int "Encoder sensor A pin value"
        range 0 34
        default 26
        
    config FOC_ENCODER_B_PIN
        int "Encoder sensor B pin value"
        range 0 34
        default 25

endmenu
```

## examples/simple_servo/main/Kconfig.projbuild
```kconfig
menu "Frerunning FoC example menu"
            
    config FOC_PWM_U_PIN
        int "Gpio number for PWM of phase U"
        range 0 34
        default 14

    config FOC_PWM_V_PIN
        int "Gpio number for PWM of phase V"
        range 0 34
        default 13

    config FOC_PWM_W_PIN
        int "Gpio number for PWM of phase W"
        range 0 34
        default 12

    config FOC_ENCODER_SDA_PIN
        int "Encoder sensor sda pin value"
        range 0 34
        default 18
        
    config FOC_ENCODER_SCL_PIN
        int "Encoder sensor scl pin value"
        range 0 34
        default 19

endmenu
```

## examples/test_drivers/test_current_sense/main/Kconfig.projbuild
```kconfig
menu "Frerunning FoC example menu"

    config FOC_PWM_U_PIN
        int "Gpio number for PWM of phase U"
        range 0 34
        default 20

    config FOC_PWM_V_PIN
        int "Gpio number for PWM of phase V"
        range 0 34
        default 3

    config FOC_PWM_W_PIN
        int "Gpio number for PWM of phase W"
        range 0 46
        default 46

    config FOC_PWM_EN_PIN
        int "Gate driver enable GPIO (or -1; reserved for MCPWM / shared with other examples)"
        range -1 54
        default -1

    config FOC_PWM_EN_ACT_LOW
        bool "Active-low enable (inverted)"
        default n
        depends on FOC_PWM_EN_PIN >= 0

    config FOC_ENCODER_SDA_PIN
        int "Encoder sensor sda pin value"
        range 0 34
        default 8

    config FOC_ENCODER_SCL_PIN
        int "Encoder sensor scl pin value"
        range 0 34
        default 9

endmenu
```

## examples/test_drivers/test_encoder/sdkconfig.defaults
```kconfig
CONFIG_ESP_TASK_WDT_EN=n

CONFIG_ESP_FOC_SCOPE=y
CONFIG_ESP_FOC_SCOPE_NUM_CHANNELS=8
CONFIG_ESP_FOC_SCOPE_BUFFER_SIZE=512
CONFIG_ESP_FOC_SCOPE_TX_ALWAYS=y
CONFIG_ESP_FOC_STREAM_BRIDGE_UART=y
CONFIG_ESP_FOC_STREAM_UART_BAUD=921600
CONFIG_ESP_FOC_STREAM_UART_TX_PIN=17
CONFIG_ESP_FOC_STREAM_UART_RX_PIN=18

CONFIG_ESP_FOC_PWM_RATE_HZ=20000

CONFIG_COMPILER_OPTIMIZATION_PERF=y
```
