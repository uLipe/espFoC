## examples/foc_sensorless_velocity/main/Kconfig.projbuild
```kconfig
menu "espFoC example: sensorless velocity"

    menu "Board: inverter"

        config EXAMPLE_PWM_U_HIGH_GPIO
            int "Phase U high-side gate GPIO"
            range 0 30
            default 18

        config EXAMPLE_PWM_U_LOW_GPIO
            int "Phase U low-side gate GPIO"
            range 0 30
            default 19

        config EXAMPLE_PWM_V_HIGH_GPIO
            int "Phase V high-side gate GPIO"
            range 0 30
            default 20

        config EXAMPLE_PWM_V_LOW_GPIO
            int "Phase V low-side gate GPIO"
            range 0 30
            default 21

        config EXAMPLE_PWM_W_HIGH_GPIO
            int "Phase W high-side gate GPIO"
            range 0 30
            default 22

        config EXAMPLE_PWM_W_LOW_GPIO
            int "Phase W low-side gate GPIO"
            range 0 30
            default 23

        config EXAMPLE_BRIDGE_ENABLE_GPIO
            int "Bridge enable GPIO (-1 = not wired)"
            range -1 30
            default 15
            help
                Gate-driver enable line. The driver holds it in the disabled
                level from init until the controller arms the bridge.

        config EXAMPLE_BRIDGE_ENABLE_ACTIVE_LOW
            bool "Bridge enable is active low"
            depends on EXAMPLE_BRIDGE_ENABLE_GPIO >= 2
            default y
            help
                Active-low enable needs GPIO 2 or above.

        config EXAMPLE_PWM_DEAD_TIME_NS
            int "Dead time between high and low side [ns]"
            range 100 5000
            default 500
            help
                Pick it from the gate driver and MOSFET datasheets: long
                enough that both FETs of a leg are never on together.

        config EXAMPLE_BRIDGE_TRIP_MA
            int "Software current trip [mA]"
            range 100 50000
            default 4000
            help
                Any phase current above this turns the bridge off within one
                PWM period. Keep it under what the bridge and the winding
                tolerate.

    endmenu

    menu "Board: current sense"

        config EXAMPLE_CURRENT_U_GPIO
            int "Phase U current sense GPIO (ADC)"
            range 0 30
            default 5

        config EXAMPLE_CURRENT_V_GPIO
            int "Phase V current sense GPIO (ADC)"
            range 0 30
            default 4

        config EXAMPLE_CURRENT_W_GPIO
            int "Phase W current sense GPIO (ADC, -1 = two shunts)"
            range -1 30
            default -1
            help
                With two shunts the third current is rebuilt from
                iu + iv + iw = 0.

        config EXAMPLE_SHUNT_MILLIOHM
            int "Shunt resistance [mOhm]"
            range 1 10000
            default 10

        config EXAMPLE_CURRENT_AMP_GAIN
            int "Current amplifier gain [V/V]"
            range 1 1000
            default 20

        config EXAMPLE_CURRENT_FILTER_HZ
            int "Current sense filter corner [Hz]"
            range 500 20000
            default 4000
            help
                Low-pass on the phase currents. The observer estimates the
                rotor angle from these currents, so it sees the PWM ripple
                this filter leaves in.

    endmenu

    menu "Motor"

        config EXAMPLE_MOTOR_POLE_PAIRS
            int "Pole pairs"
            range 1 64
            default 13
            help
                Magnet poles / 2. Identification measures R, L and the flux
                linkage, but not this.

        config EXAMPLE_DC_LINK_MILLIVOLT
            int "DC link voltage [mV]"
            range 3000 60000
            default 12000
            help
                Supply voltage of the bridge. It scales every voltage the
                controller asks for, so set the value you actually feed.

        config EXAMPLE_RATED_SPEED_RPM
            int "Rated speed [rpm]"
            range 100 60000
            default 2300
            help
                Top speed of the motor on this DC link. The controller sizes
                its speed estimator and, in speed mode, its speed loop from it,
                and turns the bridge off at 125% of it.

    endmenu

    menu "Demo cycle"

        config EXAMPLE_MINIMUM_SPEED_RPM
            int "Shaft speed at start and at the slow hold [rpm]"
            range 50 30000
            default 770
            help
                The controller starts the motor on a speed request and hands
                over from the open-loop start-up to the observer at a low
                speed. The cycle starts here, ramps to the cruise speed, comes
                back here and holds before stopping. The observer needs back
                EMF to see the rotor: do not set it too low.

        config EXAMPLE_TARGET_SPEED_RPM
            int "Shaft speed at cruise [rpm]"
            range 50 30000
            default 2000
            help
                Speed held during cruise; keep it under the rated speed.

        config EXAMPLE_ACCELERATION_MS
            int "Acceleration (minimum to cruise speed) [ms]"
            range 100 10000
            default 1000

        config EXAMPLE_CRUISE_MS
            int "Cruise [ms]"
            range 100 60000
            default 2000

        config EXAMPLE_DECELERATION_MS
            int "Deceleration (cruise to minimum speed) [ms]"
            range 100 10000
            default 1000

        config EXAMPLE_MINIMUM_HOLD_MS
            int "Hold at the minimum before stopping [ms]"
            range 0 60000
            default 2000

        config EXAMPLE_STOPPED_MS
            int "Stopped, bridge off [ms]"
            range 100 60000
            default 1000
            help
                The shaft coasts with the bridge off. The controller also
                waits for its own coast time before it starts again.

        config EXAMPLE_CYCLE_COUNT
            int "Cycles to run (0 = forever)"
            range 0 100000
            default 0
            help
                After the last cycle the controller stops and the bridge is
                turned off.

    endmenu

endmenu
```
